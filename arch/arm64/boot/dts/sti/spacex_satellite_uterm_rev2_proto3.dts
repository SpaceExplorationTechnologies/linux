/*
 * Copyright (C) 2018 STMicroelectronics (R&D) Limited.
 * Author: Nicolas Toromanoff <nicolas.toromanoff@st.com>
 *
 * This program is free software; you can redistribute it and/or modify
 * it under the terms of the GNU General Public License version 2 as
 * published by the Free Software Foundation.
 */

#include "spacex_satellite_uterm_rev2_proto2.dts"
