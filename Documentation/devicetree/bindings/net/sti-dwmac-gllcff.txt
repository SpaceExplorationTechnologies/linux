## Documentation/devicetree/bindings/net/sti-dwmac-gllcff.txt
```
STMicroelectronics GLLCFF SoC DWMAC glue layer controller

This file documents differences between the core properties in
Documentation/devicetree/bindings/net/stmmac.txt
and what is needed on STi platforms to program the stmmac glue logic.

The device node has following properties.

Refer to Documentation/devicetree/bindings/net/stmmac.txt for optional and
required properties needed for the main and platform part.

Required properties:
 - compatible:
	- "st,gllcff-dwmac0" for GMAC0
	- "st,gllcff-dwmac1" for GMAC1
 - phys: phandle to an external phy
 - phy-names: must be "gmac-phy"
 - phy-mode: can be "mii" or "gmii"
Optional properties:
 - snps,phy-addr: Indicate the ID of the Embedded PHY
 - disable-pcs: Disable PCS.
 - disable-fcs: Strip FCS from frames.

Example:

ethernet0: dwmac@16800000 {
	device_type = "network";
	compatible = "st,gllcff-dwmac";
	reg = <0x16800000 0x10000>;
	reg-names = "stmmaceth";

	reset-names = "stmmaceth";

	interrupts = <GIC_SPI 85 IRQ_TYPE_NONE>,
		     <GIC_SPI 84 IRQ_TYPE_NONE>,
		     <GIC_SPI 83 IRQ_TYPE_NONE>;
	interrupt-names = "macirq", "eth_wake_irq", "eth_lpi";

	phy-names = "gmac-phy";
	phy-mode = "gmii";
	snps,phy-addr = <0x2>;
	phys = <&ephy PHY_NONE>;

	pinctrl-names = "default";
	pinctrl-0 = <&pinctrl_mdio1>;

	resets = <&softreset GGLCFF_FC7_RST_GMAC_1_APP_N>;
	reset-names = "stmmaceth";

	clock-names = "stmmaceth", "pclk", "ptp_ref";
	clocks = <&clk_s_c0_flexgen CLK_PTP_REF_GMAC_0>,
		 <&clk_s_c0_flexgen CLK_PERIPH_1>,
		 <&clk_s_c0_flexgen CLK_PTP_REF_GMAC_0>;

	snps,pbl = <8>;

	power-domains = <&gmac1_fcgate>;

	status = "disabled";
};
```

## drivers/bus/ibi/Kconfig
```kconfig
#
# IP Bus Interface (IBI)
#

config IBI
	bool "IP Bus Interface framework"
	select REGMAP_MMIO
	help
	  Framework to configure the IP BUS interfaces such as IP Plugs or
	  ST Plugs.
```

## drivers/misc/sx/Kconfig
```kconfig
menuconfig SPACEX
	bool "SpaceX Board Support"
	select OF_EARLY_FLATTREE if OF
	select SX_TIME_BOOTSTRAP
	help
	  Enable SpaceX-specific board support features.

if SPACEX

config SX_TIME_BOOTSTRAP
	bool "SpaceX high-precision time bootstrapping"
	help
	  Enable this feature to bootstrap the system time precisely at boot
	  time.  The kernel calculates the current time using the processor's
	  cycle counter and a 64-bit /chosen/cpu-boot-time-unix-ns value in the
	  device tree.  The kernel expects that this value (along with 32-bit
	  /chosen/utc-offset) has been populated by U-Boot after it ran
	  SpaceX's "better rdate" protocol.

config SX_SIMPLE_MMAP
	tristate "SpaceX Simple mmap() Driver"
	help
	  This adds support for defining memory regions to be exported (via
	  sysfs) as mmap()able files.  This is useful for e.g. local and
	  remote Personality Module (PM) cores present on many SpaceX FPGA
	  builds.  Such cores provide Remote Input/Output (RIO) functionality.

	  Say Y if you are building for a board with such an FPGA build.

	  If unsure, say N.

config SX_PUSH_PULL
	tristate "SpaceX Push-Pull Driver"
	help
	  Support for the FIFO interfaces used in the Satellite network
	  to communicate with the FPGA networking layer and with the modems.

	  Say Y if you are building for a board with such an FPGA build.

	  If unsure, say N.

config SX_CATSON_SCP
	tristate "SpaceX Catson SCP Driver"
	help
	  Support for Catson SCP interface.

	  Say Y if you are building for a satellite modem connected to a
	  phased array beam-forming mesh.

	  If unsure, say N.

config SX_CATSON_FUSE
	tristate "SpaceX Catson Fuse Driver"
	help
	  Interface for acting with Catson fuses.

	  If unsure, say N.

endif # SPACEX
```
